## conf/layer.conf
```bitbake
# We have a conf and classes directory, add to BBPATH
BBPATH .= ":${LAYERDIR}"

# We have recipes-* directories, add to BBFILES
BBFILES += "${LAYERDIR}/recipes-*/*/*.bb \
	${LAYERDIR}/recipes-*/*/*.bbappend"

BBFILE_COLLECTIONS += "fastuidraw"
BBFILE_PATTERN_fastuidraw = "^${LAYERDIR}/"
BBFILE_PRIORITY_fastuidraw = "50"

LAYERVERSION_fastuidraw = "5"
LAYERSERIES_COMPAT_fastuidraw = "thud warrior"
```
